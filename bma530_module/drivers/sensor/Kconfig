## bma530_module/drivers/sensor/bma530/Kconfig
```kconfig
config SENSOR_BMA530
    bool "Bosch BMA530 accelerometer"
    default y
    depends on DT_HAS_BOSCH_BMA530_ENABLED
    select I2C
    help
      Enable support for the Bosch BMA530 accelerometer over I2C.
```

## bma530_module/dts/bindings/sensor/bosch,bma530.yaml
```yaml
# SPDX-License-Identifier: Apache-2.0
title: Bosch BMA530 Accelerometer
description: 3-axis low-g accelerometer with I2C/I3C/SPI interface
compatible: "bosch,bma530"

include: [sensor-device.yaml, i2c-device.yaml]

properties:
  reg:
    required: true

  int1-gpios:
    type: phandle-array
    required: false
    description: INT1 pin

  int2-gpios:
    type: phandle-array
    required: false
    description: INT2 pin

  odr:
    type: int
    required: false
    description: Output data rate in Hz 

  range:
    type: int
    required: false
    description: Full-scale range in g (2, 4, 8, 16)
```

## drivers/sensor/bma530/Kconfig
```kconfig
menuconfig SENSOR_BMA530
    bool "Bosch BMA530 accelerometer"
    depends on I2C && SENSOR
    help
      Enable support for the Bosch BMA530 accelerometer over I2C.

if SENSOR_BMA530

config SENSOR_BMA530_TRIGGER
    bool "Enable interrupts (sensor_trigger)"
    depends on GPIO

config SENSOR_BMA530_ODR_DEFAULT
    int "Default ODR (Hz)"
    default 100
    range 1 6400

config SENSOR_BMA530_RANGE_DEFAULT
    int "Default full-scale (g)"
    default 8
    range 2 16

endif
```
